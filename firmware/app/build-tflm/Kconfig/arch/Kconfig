## firmware/app/build-tflm/Kconfig/arch/Kconfig
```kconfig
# Load Zephyr Arch Kconfig descriptions.
osource "/home/aksha/zephyrproject/zephyr/arch/rx/Kconfig"
osource "/home/aksha/zephyrproject/zephyr/arch/x86/Kconfig"
osource "/home/aksha/zephyrproject/zephyr/arch/xtensa/Kconfig"
osource "/home/aksha/zephyrproject/zephyr/arch/sparc/Kconfig"
osource "/home/aksha/zephyrproject/zephyr/arch/riscv/Kconfig"
osource "/home/aksha/zephyrproject/zephyr/arch/posix/Kconfig"
osource "/home/aksha/zephyrproject/zephyr/arch/openrisc/Kconfig"
osource "/home/aksha/zephyrproject/zephyr/arch/mips/Kconfig"
osource "/home/aksha/zephyrproject/zephyr/arch/arm64/Kconfig"
osource "/home/aksha/zephyrproject/zephyr/arch/arm/Kconfig"
osource "/home/aksha/zephyrproject/zephyr/arch/arc/Kconfig"
```

## firmware/app/build-tflm/Kconfig/boards/Kconfig.stm32f4_disco
```kconfig
# Load board Kconfig descriptions.
osource "/home/aksha/zephyrproject/zephyr/boards/st/stm32f4_disco/Kconfig.stm32f4_disco"
```

## firmware/app/build-tflm/Kconfig/boards/Kconfig.sysbuild
```kconfig
# Load Sysbuild board Kconfig descriptions.
osource "/home/aksha/zephyrproject/zephyr/boards/st/stm32f4_disco/Kconfig.sysbuild"
```
