## CMakeLists.txt
```
cmake_minimum_required(VERSION 3.20.0)

find_package(Zephyr REQUIRED HINTS $ENV{ZEPHYR_BASE})

project(aegis_edge)

target_sources(app PRIVATE
    src/main.c
    src/sensor.c
    src/fault.c
    src/fault_detector.c
    src/telemetry.c
    src/config.c
    src/model_data.c
    src/ml_inference.cc
)

target_include_directories(app PRIVATE
    include
)
```

## prj.conf
```kconfig
CONFIG_CONSOLE=y
CONFIG_SERIAL=y
CONFIG_UART_CONSOLE=y

CONFIG_PRINTK=y

CONFIG_GPIO=y

CONFIG_MAIN_STACK_SIZE=2048

CONFIG_CPP=y
CONFIG_STD_CPP14=y
CONFIG_REQUIRES_FULL_LIBC=y
CONFIG_TENSORFLOW_LITE_MICRO=y
```

## src/main.c
```c
#include <zephyr/kernel.h>
#include <zephyr/sys/printk.h>

#include "fault.h"
#include "sensor.h"
#include "fault_detector.h"
#include "telemetry.h"
#include "ml_inference.h"

int main(void)
{
    sensor_data_t sensor;

    int counter = 0;

    printk("\n");
    printk("=====================================\n");
    printk("        AEGIS EDGE STARTED\n");
    printk("=====================================\n");

    telemetry_init();

    if (ml_inference_init() != 0)
    {
        printk("ML initialization FAILED\n");
    }
    else
    {
        printk("ML initialization SUCCESS\n");
    }

    while (1)
    {
        counter++;

        /* OVERHEAT */
        if (counter == 5)
        {
            printk("\n*** OVERHEAT FAULT INJECTED ***\n\n");
            fault_set(FAULT_OVERHEAT);
        }

        /* RECOVER */
        if (counter == 10)
        {
            printk("\n*** SYSTEM RECOVERED ***\n\n");
            fault_set(FAULT_NONE);
        }

        /* LOW VOLTAGE */
        if (counter == 15)
        {
            printk("\n*** LOW VOLTAGE FAULT INJECTED ***\n\n");
            fault_set(FAULT_LOW_VOLTAGE);
        }

        /* RECOVER */
        if (counter == 20)
        {
            printk("\n*** SYSTEM RECOVERED ***\n\n");
            fault_set(FAULT_NONE);
        }

        /* HIGH RPM */
        if (counter == 25)
        {
            printk("\n*** HIGH RPM FAULT INJECTED ***\n\n");
            fault_set(FAULT_HIGH_RPM);
        }

        /* RECOVER and restart test sequence */
        if (counter == 30)
        {
            printk("\n*** SYSTEM RECOVERED ***\n\n");
            fault_set(FAULT_NONE);
            counter = 0;
        }

        sensor_read(&sensor);

        ml_fault_t ml_result = ml_predict(
            sensor.temperature / 10.0f,
            sensor.voltage / 100.0f,
            (float)sensor.rpm
        );

        const char *ml_names[] = {
            "NORMAL",
            "OVERHEAT",
            "LOW_VOLTAGE",
            "HIGH_RPM"
        };

        printk("ML PREDICTION: %s\n", ml_names[ml_result]);

        fault_type_t rule_result = fault_detector_run(&sensor);
        printk("RULE PREDICTION: %s\n",telemetry_fault_name(rule_result));
        telemetry_log(&sensor, ml_result, rule_result);

        printk("------------------------------\n");

        k_sleep(K_SECONDS(2));
    }

    return 0;
}
```

## include/config.h
```c
#ifndef CONFIG_H
#define CONFIG_H

typedef struct
{
    int max_temperature;
    int min_voltage;
    int max_rpm;
} system_config_t;

const system_config_t *config_get(void);

#endif
```

## include/fault.h
```c
#ifndef FAULT_H
#define FAULT_H

typedef enum
{
    FAULT_NONE = 0,
    FAULT_OVERHEAT,
    FAULT_LOW_VOLTAGE,
    FAULT_HIGH_RPM
} fault_type_t;

void fault_set(fault_type_t fault);

fault_type_t fault_get(void);

#endif
```

## include/fault_detector.h
```c
#ifndef FAULT_DETECTOR_H
#define FAULT_DETECTOR_H

#include "sensor.h"
#include "fault.h"

fault_type_t fault_detector_run(const sensor_data_t *data);

#endif
```

## include/ml_inference.h
```c
#ifndef ML_INFERENCE_H
#define ML_INFERENCE_H

#include <stdint.h>

#ifdef __cplusplus
extern "C" {
#endif

typedef enum {
    ML_FAULT_NORMAL = 0,
    ML_FAULT_OVERHEAT = 1,
    ML_FAULT_LOW_VOLTAGE = 2,
    ML_FAULT_HIGH_RPM = 3
} ml_fault_t;

int ml_inference_init(void);

ml_fault_t ml_predict(float temperature, float voltage, float rpm);

#ifdef __cplusplus
}
#endif

#endif
```

## include/model_data.h
```c
#ifndef MODEL_DATA_H
#define MODEL_DATA_H

#include <stddef.h>

extern const unsigned char aegis_fault_model_int8_tflite[];
extern const unsigned int aegis_fault_model_int8_tflite_len;

#endif
```

## include/sensor.h
```c
#ifndef SENSOR_H
#define SENSOR_H

typedef struct
{
    int temperature;   // x10
    int voltage;       // x100
    int rpm;

} sensor_data_t;

void sensor_read(sensor_data_t *data);

#endif
```

## include/telemetry.h
```c
#ifndef TELEMETRY_H
#define TELEMETRY_H

#include "sensor.h"
#include "fault.h"
#include "ml_inference.h"

void telemetry_init(void);
void telemetry_log(const sensor_data_t *sensor,
                   ml_fault_t ml_result,
                   fault_type_t rule_result);

const char *telemetry_fault_name(fault_type_t fault);

#endif
```

## src/config.c
```c
#include "config.h"

static const system_config_t system_config =
{
    .max_temperature = 800,
    .min_voltage = 300,
    .max_rpm = 3000
};

const system_config_t *config_get(void)
{
    return &system_config;
}
```

## src/fault.c
```c
#include "fault.h"

static fault_type_t current_fault = FAULT_NONE;

void fault_set(fault_type_t fault)
{
    current_fault = fault;
}

fault_type_t fault_get(void)
{
    return current_fault;
}
```

## src/fault_detector.c
```c
#include <zephyr/sys/printk.h>

#include "fault_detector.h"
#include "config.h"
#include "fault.h"

fault_type_t fault_detector_run(const sensor_data_t *data)
{
    const system_config_t *config = config_get();

    if (data->temperature > config->max_temperature)
    {
        printk("ALERT: OVERHEAT DETECTED!\n");
        return FAULT_OVERHEAT;
    }

    if (data->voltage < config->min_voltage)
    {
        printk("ALERT: LOW VOLTAGE DETECTED!\n");
        return FAULT_LOW_VOLTAGE;
    }

    if (data->rpm > config->max_rpm)
    {
        printk("ALERT: HIGH RPM DETECTED!\n");
        return FAULT_HIGH_RPM;
    }

    return FAULT_NONE;
}
```

## src/ml_inference.cc
```c
#include "ml_inference.h"

#include <math.h>
#include <stdint.h>

#include "zephyr/kernel.h"
#include "zephyr/sys/printk.h"
#include "zephyr/timing/timing.h"

#include "model_data.h"

#include "tensorflow/lite/micro/micro_interpreter.h"
#include "tensorflow/lite/micro/micro_mutable_op_resolver.h"
#include "tensorflow/lite/schema/schema_generated.h"

namespace {

constexpr size_t kTensorArenaSize = 16 * 1024;
alignas(16) uint8_t tensor_arena[kTensorArenaSize];

const tflite::Model* model = nullptr;
tflite::MicroInterpreter* interpreter = nullptr;
TfLiteTensor* input_tensor = nullptr;
TfLiteTensor* output_tensor = nullptr;

tflite::MicroMutableOpResolver<2> resolver;

bool initialized = false;

uint32_t inference_count = 0;
uint32_t inference_min_cycles = UINT32_MAX;
uint32_t inference_max_cycles = 0;
uint64_t inference_total_cycles = 0;


}  // namespace

extern "C" int ml_inference_init(void)
{
    printk("Aegis ML: initializing TFLM...\n");

    model = tflite::GetModel(aegis_fault_model_int8_tflite);

    if (model == nullptr) {
        printk("Aegis ML: failed to load model\n");
        return -1;
    }

    if (model->version() != TFLITE_SCHEMA_VERSION) {
        printk("Aegis ML: schema mismatch: model=%d runtime=%d\n",
               model->version(),
               TFLITE_SCHEMA_VERSION);
        return -2;
    }

    if (resolver.AddFullyConnected() != kTfLiteOk) {
        printk("Aegis ML: failed to register FullyConnected\n");
        return -3;
    }

    if (resolver.AddSoftmax() != kTfLiteOk) {
        printk("Aegis ML: failed to register Softmax\n");
        return -4;
    }

    static tflite::MicroInterpreter static_interpreter(
        model,
        resolver,
        tensor_arena,
        kTensorArenaSize);

    interpreter = &static_interpreter;

    if (interpreter->AllocateTensors() != kTfLiteOk) {
        printk("Aegis ML: AllocateTensors() failed\n");
        return -5;
    }

    input_tensor = interpreter->input(0);
    output_tensor = interpreter->output(0);

    if (input_tensor == nullptr || output_tensor == nullptr) {
        printk("Aegis ML: invalid input/output tensor\n");
        return -6;
    }

    printk("Aegis ML: initialized successfully\n");

    printk("Aegis ML: input type=%d shape=[%d,%d]\n",
           input_tensor->type,
           input_tensor->dims->data[0],
           input_tensor->dims->data[1]);

    printk("Aegis ML: input scale=%f zero_point=%d\n",
           (double)input_tensor->params.scale,
           input_tensor->params.zero_point);

    printk("Aegis ML: output type=%d shape=[%d,%d]\n",
           output_tensor->type,
           output_tensor->dims->data[0],
           output_tensor->dims->data[1]);

    printk("Aegis ML: output scale=%f zero_point=%d\n",
           (double)output_tensor->params.scale,
           output_tensor->params.zero_point);

    initialized = true;

    return 0;
}

extern "C" ml_fault_t ml_predict(
    float temperature,
    float voltage,
    float rpm)
{
    if (!initialized) {
        printk("Aegis ML: not initialized\n");
        return ML_FAULT_NORMAL;
    }

    /*
     * The model was trained with the three input features rescaled to
     * approximately [0, 1].
     *
     * Feature scales:
     *   temperature -> 100
     *   voltage     -> 4
     *   rpm         -> 5000
     */

    const float features[3] = {
        temperature / 100.0f,
        voltage / 4.0f,
        rpm / 5000.0f
    };

    const float input_scale = input_tensor->params.scale;
    const int input_zero_point = input_tensor->params.zero_point;

    for (int i = 0; i < 3; ++i) {

        const float division = features[i] / input_scale;
        const float rounded = roundf(division);

        const int32_t quantized =
            static_cast<int32_t>(rounded) + input_zero_point;

        int32_t clamped = quantized;

        if (clamped > 127) {
            clamped = 127;
        } else if (clamped < -128) {
            clamped = -128;
        }

        input_tensor->data.int8[i] =
            static_cast<int8_t>(clamped);

    }

    uint32_t start_cycles = k_cycle_get_32();

if (interpreter->Invoke() != kTfLiteOk) {
    printk("Aegis ML: Invoke() failed\n");
    return ML_FAULT_NORMAL;
}

uint32_t elapsed_cycles = k_cycle_get_32() - start_cycles;

inference_count++;
inference_total_cycles += elapsed_cycles;

if (elapsed_cycles < inference_min_cycles) {
    inference_min_cycles = elapsed_cycles;
}

if (elapsed_cycles > inference_max_cycles) {
    inference_max_cycles = elapsed_cycles;
}

uint32_t elapsed_us =
    k_cyc_to_us_near32(elapsed_cycles);

printk("TFLM INFERENCE: %u us\n", elapsed_us);

if (inference_count % 10 == 0) {
    uint32_t avg_cycles =
        inference_total_cycles / inference_count;

    uint32_t avg_us =
        k_cyc_to_us_near32(avg_cycles);

    uint32_t min_us =
        k_cyc_to_us_near32(inference_min_cycles);

    uint32_t max_us =
        k_cyc_to_us_near32(inference_max_cycles);

    printk(
        "TFLM LATENCY: samples=%u min=%u us avg=%u us max=%u us\n",
        inference_count,
        min_us,
        avg_us,
        max_us
    );
}

    int best_index = 0;
    int8_t best_value = output_tensor->data.int8[0];

    for (int i = 1; i < 4; ++i) {
        if (output_tensor->data.int8[i] > best_value) {
            best_value = output_tensor->data.int8[i];
            best_index = i;
        }
    }

    return static_cast<ml_fault_t>(best_index);
}
```

## src/model_data.c
```c
unsigned char aegis_fault_model_int8_tflite[] = {
  0x20, 0x00, 0x00, 0x00, 0x54, 0x46, 0x4c, 0x33, 0x00, 0x00, 0x00, 0x00,
  0x14, 0x00, 0x20, 0x00, 0x1c, 0x00, 0x18, 0x00, 0x14, 0x00, 0x10, 0x00,
  0x0c, 0x00, 0x00, 0x00, 0x08, 0x00, 0x04, 0x00, 0x14, 0x00, 0x00, 0x00,
  0x1c, 0x00, 0x00, 0x00, 0x94, 0x00, 0x00, 0x00, 0xec, 0x00, 0x00, 0x00,
  0x4c, 0x03, 0x00, 0x00, 0x5c, 0x03, 0x00, 0x00, 0x38, 0x0d, 0x00, 0x00,
  0x03, 0x00, 0x00, 0x00, 0x01, 0x00, 0x00, 0x00, 0x10, 0x00, 0x00, 0x00,
  0x00, 0x00, 0x0a, 0x00, 0x10, 0x00, 0x0c, 0x00, 0x08, 0x00, 0x04, 0x00,
  0x0a, 0x00, 0x00, 0x00, 0x0c, 0x00, 0x00, 0x00, 0x1c, 0x00, 0x00, 0x00,
  0x3c, 0x00, 0x00, 0x00, 0x0f, 0x00, 0x00, 0x00, 0x73, 0x65, 0x72, 0x76,
  0x69, 0x6e, 0x67, 0x5f, 0x64, 0x65, 0x66, 0x61, 0x75, 0x6c, 0x74, 0x00,
  0x01, 0x00, 0x00, 0x00, 0x04, 0x00, 0x00, 0x00, 0x94, 0xff, 0xff, 0xff,
  0x0a, 0x00, 0x00, 0x00, 0x04, 0x00, 0x00, 0x00, 0x08, 0x00, 0x00, 0x00,
  0x6f, 0x75, 0x74, 0x70, 0x75, 0x74, 0x5f, 0x30, 0x00, 0x00, 0x00, 0x00,
  0x01, 0x00, 0x00, 0x00, 0x04, 0x00, 0x00, 0x00, 0x9a, 0xfc, 0xff, 0xff,
  0x04, 0x00, 0x00, 0x00, 0x0b, 0x00, 0x00, 0x00, 0x69, 0x6e, 0x70, 0x75,
  0x74, 0x5f, 0x6c, 0x61, 0x79, 0x65, 0x72, 0x00, 0x02, 0x00, 0x00, 0x00,
  0x34, 0x00, 0x00, 0x00, 0x04, 0x00, 0x00, 0x00, 0xdc, 0xff, 0xff, 0xff,
  0x0d, 0x00, 0x00, 0x00, 0x04, 0x00, 0x00, 0x00, 0x13, 0x00, 0x00, 0x00,
  0x43, 0x4f, 0x4e, 0x56, 0x45, 0x52, 0x53, 0x49, 0x4f, 0x4e, 0x5f, 0x4d,
  0x45, 0x54, 0x41, 0x44, 0x41, 0x54, 0x41, 0x00, 0x08, 0x00, 0x0c, 0x00,
  0x08, 0x00, 0x04, 0x00, 0x08, 0x00, 0x00, 0x00, 0x0c, 0x00, 0x00, 0x00,
  0x04, 0x00, 0x00, 0x00, 0x13, 0x00, 0x00, 0x00, 0x6d, 0x69, 0x6e, 0x5f,
  0x72, 0x75, 0x6e, 0x74, 0x69, 0x6d, 0x65, 0x5f, 0x76, 0x65, 0x72, 0x73,
  0x69, 0x6f, 0x6e, 0x00, 0x0e, 0x00, 0x00, 0x00, 0x5c, 0x02, 0x00, 0x00,
  0x54, 0x02, 0x00, 0x00, 0x34, 0x02, 0x00, 0x00, 0x04, 0x02, 0x00, 0x00,
  0xd4, 0x01, 0x00, 0x00, 0x44, 0x01, 0x00, 0x00, 0xf4, 0x00, 0x00, 0x00,
  0xb4, 0x00, 0x00, 0x00, 0xac, 0x00, 0x00, 0x00, 0xa4, 0x00, 0x00, 0x00,
  0x9c, 0x00, 0x00, 0x00, 0x94, 0x00, 0x00, 0x00, 0x74, 0x00, 0x00, 0x00,
  0x04, 0x00, 0x00, 0x00, 0x4a, 0xfd, 0xff, 0xff, 0x04, 0x00, 0x00, 0x00,
  0x60, 0x00, 0x00, 0x00, 0x0c, 0x00, 0x00, 0x00, 0x08, 0x00, 0x0e, 0x00,
  0x08, 0x00, 0x04, 0x00, 0x08, 0x00, 0x00, 0x00, 0x10, 0x00, 0x00, 0x00,
  0x28, 0x00, 0x00, 0x00, 0x00, 0x00, 0x06, 0x00, 0x08, 0x00, 0x04, 0x00,
  0x06, 0x00, 0x00, 0x00, 0x04, 0x00, 0x00, 0x00, 0x01, 0x00, 0x00, 0x00,
  0xeb, 0x03, 0x00, 0x00, 0x0c, 0x00, 0x18, 0x00, 0x14, 0x00, 0x10, 0x00,
  0x0c, 0x00, 0x04, 0x00, 0x0c, 0x00, 0x00, 0x00, 0xf5, 0xd9, 0x0a, 0x80,
  0x0d, 0x71, 0x42, 0xe3, 0x02, 0x00, 0x00, 0x00, 0x02, 0x00, 0x00, 0x00,
  0x04, 0x00, 0x00, 0x00, 0x06, 0x00, 0x00, 0x00, 0x32, 0x2e, 0x32, 0x31,
  0x2e, 0x30, 0x00, 0x00, 0xb6, 0xfd, 0xff, 0xff, 0x04, 0x00, 0x00, 0x00,
  0x10, 0x00, 0x00, 0x00, 0x31, 0x2e, 0x31, 0x34, 0x2e, 0x30, 0x00, 0x00,
  0x00, 0x00, 0x00, 0x00, 0x00, 0x00, 0x00, 0x00, 0xa0, 0xfd, 0xff, 0xff,
  0xa4, 0xfd, 0xff, 0xff, 0xa8, 0xfd, 0xff, 0xff, 0xac, 0xfd, 0xff, 0xff,
  0xe2, 0xfd, 0xff, 0xff, 0x04, 0x00, 0x00, 0x00, 0x30, 0x00, 0x00, 0x00,
  0x48, 0x5b, 0x7f, 0x68, 0xf2, 0x81, 0x1d, 0xf9, 0x81, 0x1d, 0x7f, 0x63,
  0x00, 0x51, 0x7f, 0xce, 0x6d, 0x7f, 0x7f, 0x63, 0x30, 0x58, 0x81, 0x46,
  0x7f, 0x36, 0xe6, 0x7d, 0x11, 0x81, 0x8d, 0x81, 0xae, 0xdc, 0x29, 0x7f,
  0x31, 0x2d, 0x81, 0xf3, 0x1f, 0x81, 0xb1, 0x3b, 0x7f, 0xfb, 0x82, 0x81,
  0x1e, 0xfe, 0xff, 0xff, 0x04, 0x00, 0x00, 0x00, 0x40, 0x00, 0x00, 0x00,
  0x61, 0xd0, 0xff, 0xff, 0x15, 0x4c, 0x00, 0x00, 0x00, 0x00, 0x00, 0x00,
  0xcc, 0x39, 0x00, 0x00, 0x7b, 0xfc, 0xff, 0xff, 0x3d, 0xff, 0xff, 0xff,
  0xb4, 0xab, 0xff, 0xff, 0x29, 0xf0, 0xff, 0xff, 0x95, 0xc4, 0xff, 0xff,
  0x33, 0x20, 0x00, 0x00, 0x00, 0x00, 0x00, 0x00, 0xa2, 0xe6, 0xff, 0xff,
  0x05, 0x62, 0x00, 0x00, 0xad, 0x7b, 0x00, 0x00, 0xcd, 0xf0, 0xff, 0xff,
  0x00, 0x00, 0x00, 0x00, 0x6a, 0xfe, 0xff, 0xff, 0x04, 0x00, 0x00, 0x00,
  0x80, 0x00, 0x00, 0x00, 0xa9, 0x37, 0x70, 0xf6, 0x89, 0x8b, 0x7f, 0x5f,
  0xda, 0xa2, 0x18, 0x27, 0xaa, 0x1b, 0x4c, 0x79, 0xea, 0xe3, 0x1c, 0x90,
  0x81, 0xbe, 0x68, 0x1f, 0x31, 0x58, 0xb3, 0xd3, 0xd3, 0x55, 0x76, 0x3a,
  0x05, 0x49, 0x62, 0x38, 0xdd, 0x44, 0xbf, 0xb9, 0xce, 0xc8, 0xf5, 0xc6,
  0x81, 0x9e, 0xe4, 0x34, 0xb5, 0xcc, 0xd4, 0x27, 0x0f, 0xb3, 0x7c, 0x97,
  0x81, 0xb7, 0xc8, 0x52, 0xc3, 0x26, 0xab, 0x6f, 0x5a, 0x8e, 0xe5, 0x10,
  0x4a, 0x2f, 0x5e, 0xeb, 0x7f, 0xcf, 0x13, 0x72, 0xb6, 0x9e, 0x46, 0xfe,
  0x3c, 0x93, 0x2a, 0x28, 0x31, 0x5c, 0x76, 0x15, 0x58, 0xb9, 0x14, 0x6c,
  0x87, 0x9f, 0x7f, 0x23, 0x31, 0x66, 0x00, 0x37, 0x18, 0x0b, 0x4d, 0xfd,
  0x59, 0x76, 0x1c, 0xdc, 0x7f, 0x37, 0xa9, 0x15, 0xfe, 0xe5, 0xfa, 0x23,
  0x28, 0x32, 0xb1, 0x0a, 0x81, 0xc8, 0xe9, 0x2b, 0x16, 0x2f, 0x3b, 0x1e,
  0xf6, 0xfe, 0xff, 0xff, 0x04, 0x00, 0x00, 0x00, 0x20, 0x00, 0x00, 0x00,
  0x00, 0x00, 0x00, 0x00, 0x69, 0xfb, 0xff, 0xff, 0x74, 0xfe, 0xff, 0xff,
  0x30, 0xfe, 0xff, 0xff, 0xfb, 0xf0, 0xff, 0xff, 0xc2, 0xf2, 0xff, 0xff,
  0x72, 0x0a, 0x00, 0x00, 0xdf, 0x0e, 0x00, 0x00, 0x22, 0xff, 0xff, 0xff,
  0x04, 0x00, 0x00, 0x00, 0x20, 0x00, 0x00, 0x00, 0xf5, 0x2e, 0xeb, 0xc3,
  0x7f, 0x4f, 0x1c, 0xda, 0x06, 0xf5, 0xf2, 0xe4, 0xb0, 0x9c, 0x3c, 0x81,
  0xcf, 0xf6, 0xf7, 0x08, 0x81, 0x90, 0x04, 0x7c, 0x25, 0x10, 0xd3, 0xd3,
  0x62, 0x7f, 0x85, 0x65, 0x4e, 0xff, 0xff, 0xff, 0x04, 0x00, 0x00, 0x00,
  0x10, 0x00, 0x00, 0x00, 0x5b, 0xfd, 0xff, 0xff, 0x71, 0x01, 0x00, 0x00,
  0x48, 0x03, 0x00, 0x00, 0x4f, 0xfd, 0xff, 0xff, 0x38, 0xff, 0xff, 0xff,
  0x3c, 0xff, 0xff, 0xff, 0x0f, 0x00, 0x00, 0x00, 0x4d, 0x4c, 0x49, 0x52,
  0x20, 0x43, 0x6f, 0x6e, 0x76, 0x65, 0x72, 0x74, 0x65, 0x64, 0x2e, 0x00,
  0x01, 0x00, 0x00, 0x00, 0x14, 0x00, 0x00, 0x00, 0x00, 0x00, 0x0e, 0x00,
  0x18, 0x00, 0x14, 0x00, 0x10, 0x00, 0x0c, 0x00, 0x08, 0x00, 0x04, 0x00,
  0x0e, 0x00, 0x00, 0x00, 0x14, 0x00, 0x00, 0x00, 0x1c, 0x00, 0x00, 0x00,
  0x38, 0x01, 0x00, 0x00, 0x3c, 0x01, 0x00, 0x00, 0x40, 0x01, 0x00, 0x00,
  0x04, 0x00, 0x00, 0x00, 0x6d, 0x61, 0x69, 0x6e, 0x00, 0x00, 0x00, 0x00,
  0x04, 0x00, 0x00, 0x00, 0xe0, 0x00, 0x00, 0x00, 0x98, 0x00, 0x00, 0x00,
  0x50, 0x00, 0x00, 0x00, 0x14, 0x00, 0x00, 0x00, 0x00, 0x00, 0x0e, 0x00,
  0x1a, 0x00, 0x14, 0x00, 0x10, 0x00, 0x0c, 0x00, 0x0b, 0x00, 0x04, 0x00,
  0x0e, 0x00, 0x00, 0x00, 0x1c, 0x00, 0x00, 0x00, 0x00, 0x00, 0x00, 0x09,
  0x1c, 0x00, 0x00, 0x00, 0x20, 0x00, 0x00, 0x00, 0x01, 0x00, 0x00, 0x00,
  0x00, 0x00, 0x06, 0x00, 0x08, 0x00, 0x04, 0x00, 0x06, 0x00, 0x00, 0x00,
  0x00, 0x00, 0x80, 0x3f, 0x01, 0x00, 0x00, 0x00, 0x0a, 0x00, 0x00, 0x00,
  0x01, 0x00, 0x00, 0x00, 0x09, 0x00, 0x00, 0x00, 0xca, 0xff, 0xff, 0xff,
  0x14, 0x00, 0x00, 0x00, 0x00, 0x00, 0x00, 0x08, 0x10, 0x00, 0x00, 0x00,
  0x14, 0x00, 0x00, 0x00, 0x04, 0x00, 0x04, 0x00, 0x04, 0x00, 0x00, 0x00,
  0x01, 0x00, 0x00, 0x00, 0x09, 0x00, 0x00, 0x00, 0x03, 0x00, 0x00, 0x00,
  0x08, 0x00, 0x00, 0x00, 0x02, 0x00, 0x00, 0x00, 0x01, 0x00, 0x00, 0x00,
  0x00, 0x00, 0x0e, 0x00, 0x14, 0x00, 0x00, 0x00, 0x10, 0x00, 0x0c, 0x00,
  0x0b, 0x00, 0x04, 0x00, 0x0e, 0x00, 0x00, 0x00, 0x10, 0x00, 0x00, 0x00,
  0x00, 0x00, 0x00, 0x08, 0x10, 0x00, 0x00, 0x00, 0x14, 0x00, 0x00, 0x00,
  0xba, 0xff, 0xff, 0xff, 0x00, 0x00, 0x00, 0x01, 0x01, 0x00, 0x00, 0x00,
  0x08, 0x00, 0x00, 0x00, 0x03, 0x00, 0x00, 0x00, 0x07, 0x00, 0x00, 0x00,
  0x04, 0x00, 0x00, 0x00, 0x03, 0x00, 0x00, 0x00, 0x00, 0x00, 0x0e, 0x00,
  0x16, 0x00, 0x00, 0x00, 0x10, 0x00, 0x0c, 0x00, 0x0b, 0x00, 0x04, 0x00,
  0x0e, 0x00, 0x00, 0x00, 0x18, 0x00, 0x00, 0x00, 0x00, 0x00, 0x00, 0x08,
  0x18, 0x00, 0x00, 0x00, 0x1c, 0x00, 0x00, 0x00, 0x00, 0x00, 0x06, 0x00,
  0x08, 0x00, 0x07, 0x00, 0x06, 0x00, 0x00, 0x00, 0x00, 0x00, 0x00, 0x01,
  0x01, 0x00, 0x00, 0x00, 0x07, 0x00, 0x00, 0x00, 0x03, 0x00, 0x00, 0x00,
  0x00, 0x00, 0x00, 0x00, 0x06, 0x00, 0x00, 0x00, 0x05, 0x00, 0x00, 0x00,
  0x01, 0x00, 0x00, 0x00, 0x0a, 0x00, 0x00, 0x00, 0x01, 0x00, 0x00, 0x00,
  0x00, 0x00, 0x00, 0x00, 0x0b, 0x00, 0x00, 0x00, 0xe8, 0x07, 0x00, 0x00,
  0x40, 0x07, 0x00, 0x00, 0x94, 0x06, 0x00, 0x00, 0xb8, 0x05, 0x00, 0x00,
  0xf4, 0x04, 0x00, 0x00, 0xb8, 0x03, 0x00, 0x00, 0x94, 0x02, 0x00, 0x00,
  0xe0, 0x01, 0x00, 0x00, 0x24, 0x01, 0x00, 0x00, 0x80, 0x00, 0x00, 0x00,
  0x04, 0x00, 0x00, 0x00, 0x5a, 0xf8, 0xff, 0xff, 0x00, 0x00, 0x00, 0x01,
  0x18, 0x00, 0x00, 0x00, 0x20, 0x00, 0x00, 0x00, 0x3c, 0x00, 0x00, 0x00,
  0x0b, 0x00, 0x00, 0x00, 0x00, 0x00, 0x00, 0x09, 0x50, 0x00, 0x00, 0x00,
  0x02, 0x00, 0x00, 0x00, 0xff, 0xff, 0xff, 0xff, 0x04, 0x00, 0x00, 0x00,
  0x44, 0xf8, 0xff, 0xff, 0x08, 0x00, 0x00, 0x00, 0x10, 0x00, 0x00, 0x00,
  0x01, 0x00, 0x00, 0x00, 0x80, 0xff, 0xff, 0xff, 0xff, 0xff, 0xff, 0xff,
  0x01, 0x00, 0x00, 0x00, 0x00, 0x00, 0x80, 0x3b, 0x1b, 0x00, 0x00, 0x00,
  0x53, 0x74, 0x61, 0x74, 0x65, 0x66, 0x75, 0x6c, 0x50, 0x61, 0x72, 0x74,
  0x69, 0x74, 0x69, 0x6f, 0x6e, 0x65, 0x64, 0x43, 0x61, 0x6c, 0x6c, 0x5f,
  0x31, 0x3a, 0x30, 0x00, 0x02, 0x00, 0x00, 0x00, 0x01, 0x00, 0x00, 0x00,
  0x04, 0x00, 0x00, 0x00, 0xd2, 0xf8, 0xff, 0xff, 0x00, 0x00, 0x00, 0x01,
  0x18, 0x00, 0x00, 0x00, 0x20, 0x00, 0x00, 0x00, 0x40, 0x00, 0x00, 0x00,
  0x0a, 0x00, 0x00, 0x00, 0x00, 0x00, 0x00, 0x09, 0x78, 0x00, 0x00, 0x00,
  0x02, 0x00, 0x00, 0x00, 0xff, 0xff, 0xff, 0xff, 0x04, 0x00, 0x00, 0x00,
  0xbc, 0xf8, 0xff, 0xff, 0x08, 0x00, 0x00, 0x00, 0x14, 0x00, 0x00, 0x00,
  0x01, 0x00, 0x00, 0x00, 0x0f, 0x00, 0x00, 0x00, 0x00, 0x00, 0x00, 0x00,
  0x00, 0x00, 0x00, 0x00, 0x01, 0x00, 0x00, 0x00, 0xcc, 0x02, 0x91, 0x3e,
  0x3c, 0x00, 0x00, 0x00, 0x73, 0x65, 0x71, 0x75, 0x65, 0x6e, 0x74, 0x69,
  0x61, 0x6c, 0x5f, 0x31, 0x2f, 0x64, 0x65, 0x6e, 0x73, 0x65, 0x5f, 0x32,
  0x5f, 0x31, 0x2f, 0x4d, 0x61, 0x74, 0x4d, 0x75, 0x6c, 0x3b, 0x73, 0x65,
  0x71, 0x75, 0x65, 0x6e, 0x74, 0x69, 0x61, 0x6c, 0x5f, 0x31, 0x2f, 0x64,
  0x65, 0x6e, 0x73, 0x65, 0x5f, 0x32, 0x5f, 0x31, 0x2f, 0x42, 0x69, 0x61,
  0x73, 0x41, 0x64, 0x64, 0x00, 0x00, 0x00, 0x00, 0x02, 0x00, 0x00, 0x00,
  0x01, 0x00, 0x00, 0x00, 0x04, 0x00, 0x00, 0x00, 0x72, 0xf9, 0xff, 0xff,
  0x00, 0x00, 0x00, 0x01, 0x18, 0x00, 0x00, 0x00, 0x20, 0x00, 0x00, 0x00,
  0x3c, 0x00, 0x00, 0x00, 0x09, 0x00, 0x00, 0x00, 0x00, 0x00, 0x00, 0x09,
  0x90, 0x00, 0x00, 0x00, 0x02, 0x00, 0x00, 0x00, 0xff, 0xff, 0xff, 0xff,
  0x08, 0x00, 0x00, 0x00, 0x5c, 0xf9, 0xff, 0xff, 0x08, 0x00, 0x00, 0x00,
  0x10, 0x00, 0x00, 0x00, 0x01, 0x00, 0x00, 0x00, 0x80, 0xff, 0xff, 0xff,
  0xff, 0xff, 0xff, 0xff, 0x01, 0x00, 0x00, 0x00, 0xd0, 0x5e, 0x79, 0x3d,
  0x58, 0x00, 0x00, 0x00, 0x73, 0x65, 0x71, 0x75, 0x65, 0x6e, 0x74, 0x69,
  0x61, 0x6c, 0x5f, 0x31, 0x2f, 0x64, 0x65, 0x6e, 0x73, 0x65, 0x5f, 0x31,
  0x5f, 0x32, 0x2f, 0x4d, 0x61, 0x74, 0x4d, 0x75, 0x6c, 0x3b, 0x73, 0x65,
  0x71, 0x75, 0x65, 0x6e, 0x74, 0x69, 0x61, 0x6c, 0x5f, 0x31, 0x2f, 0x64,
  0x65, 0x6e, 0x73, 0x65, 0x5f, 0x31, 0x5f, 0x32, 0x2f, 0x52, 0x65, 0x6c,
  0x75, 0x3b, 0x73, 0x65, 0x71, 0x75, 0x65, 0x6e, 0x74, 0x69, 0x61, 0x6c,
  0x5f, 0x31, 0x2f, 0x64, 0x65, 0x6e, 0x73, 0x65, 0x5f, 0x31, 0x5f, 0x32,
  0x2f, 0x42, 0x69, 0x61, 0x73, 0x41, 0x64, 0x64, 0x00, 0x00, 0x00, 0x00,
  0x02, 0x00, 0x00, 0x00, 0x01, 0x00, 0x00, 0x00, 0x08, 0x00, 0x00, 0x00,
  0x2a, 0xfa, 0xff, 0xff, 0x00, 0x00, 0x00, 0x01, 0x18, 0x00, 0x00, 0x00,
  0x20, 0x00, 0x00, 0x00, 0x3c, 0x00, 0x00, 0x00, 0x08, 0x00, 0x00, 0x00,
  0x00, 0x00, 0x00, 0x09, 0x88, 0x00, 0x00, 0x00, 0x02, 0x00, 0x00, 0x00,
  0xff, 0xff, 0xff, 0xff, 0x10, 0x00, 0x00, 0x00, 0x14, 0xfa, 0xff, 0xff,
  0x08, 0x00, 0x00, 0x00, 0x10, 0x00, 0x00, 0x00, 0x01, 0x00, 0x00, 0x00,
  0x80, 0xff, 0xff, 0xff, 0xff, 0xff, 0xff, 0xff, 0x01, 0x00, 0x00, 0x00,
  0xa3, 0x10, 0x4b, 0x3c, 0x52, 0x00, 0x00, 0x00, 0x73, 0x65, 0x71, 0x75,
  0x65, 0x6e, 0x74, 0x69, 0x61, 0x6c, 0x5f, 0x31, 0x2f, 0x64, 0x65, 0x6e,
  0x73, 0x65, 0x5f, 0x31, 0x2f, 0x4d, 0x61, 0x74, 0x4d, 0x75, 0x6c, 0x3b,
  0x73, 0x65, 0x71, 0x75, 0x65, 0x6e, 0x74, 0x69, 0x61, 0x6c, 0x5f, 0x31,
  0x2f, 0x64, 0x65, 0x6e, 0x73, 0x65, 0x5f, 0x31, 0x2f, 0x52, 0x65, 0x6c,
  0x75, 0x3b, 0x73, 0x65, 0x71, 0x75, 0x65, 0x6e, 0x74, 0x69, 0x61, 0x6c,
  0x5f, 0x31, 0x2f, 0x64, 0x65, 0x6e, 0x73, 0x65, 0x5f, 0x31, 0x2f, 0x42,
  0x69, 0x61, 0x73, 0x41, 0x64, 0x64, 0x00, 0x00, 0x02, 0x00, 0x00, 0x00,
  0x01, 0x00, 0x00, 0x00, 0x10, 0x00, 0x00, 0x00, 0x7e, 0xfb, 0xff, 0xff,
  0x00, 0x00, 0x00, 0x01, 0x14, 0x00, 0x00, 0x00, 0xe8, 0x00, 0x00, 0x00,
  0x07, 0x00, 0x00, 0x00, 0x00, 0x00, 0x00, 0x09, 0xfc, 0x00, 0x00, 0x00,
  0xb4, 0xfa, 0xff, 0xff, 0x08, 0x00, 0x00, 0x00, 0x8c, 0x00, 0x00, 0x00,
  0x10, 0x00, 0x00, 0x00, 0x00, 0x00, 0x00, 0x00, 0x00, 0x00, 0x00, 0x00,
  0x00, 0x00, 0x00, 0x00, 0x00, 0x00, 0x00, 0x00, 0x00, 0x00, 0x00, 0x00,
  0x00, 0x00, 0x00, 0x00, 0x00, 0x00, 0x00, 0x00, 0x00, 0x00, 0x00, 0x00,
  0x00, 0x00, 0x00, 0x00, 0x00, 0x00, 0x00, 0x00, 0x00, 0x00, 0x00, 0x00,
  0x00, 0x00, 0x00, 0x00, 0x00, 0x00, 0x00, 0x00, 0x00, 0x00, 0x00, 0x00,
  0x00, 0x00, 0x00, 0x00, 0x00, 0x00, 0x00, 0x00, 0x00, 0x00, 0x00, 0x00,
  0x00, 0x00, 0x00, 0x00, 0x00, 0x00, 0x00, 0x00, 0x00, 0x00, 0x00, 0x00,
  0x00, 0x00, 0x00, 0x00, 0x00, 0x00, 0x00, 0x00, 0x00, 0x00, 0x00, 0x00,
  0x00, 0x00, 0x00, 0x00, 0x00, 0x00, 0x00, 0x00, 0x00, 0x00, 0x00, 0x00,
  0x00, 0x00, 0x00, 0x00, 0x00, 0x00, 0x00, 0x00, 0x00, 0x00, 0x00, 0x00,
  0x00, 0x00, 0x00, 0x00, 0x00, 0x00, 0x00, 0x00, 0x00, 0x00, 0x00, 0x00,
  0x00, 0x00, 0x00, 0x00, 0x10, 0x00, 0x00, 0x00, 0xb1, 0x67, 0x02, 0x3c,
  0x4e, 0x01, 0x15, 0x3c, 0x55, 0x70, 0x7c, 0x3b, 0x89, 0x62, 0x45, 0x3c,
  0xb6, 0x90, 0x2a, 0x3c, 0xfe, 0x64, 0x32, 0x3c, 0x30, 0x00, 0x1a, 0x3c,
  0x67, 0x49, 0x6a, 0x3b, 0xde, 0x14, 0x4f, 0x3c, 0x22, 0x6c, 0x56, 0x3c,
  0x59, 0xb4, 0x59, 0x3b, 0x2e, 0x57, 0x5c, 0x3c, 0x8d, 0xbb, 0x3c, 0x3c,
  0xa9, 0xc9, 0xcd, 0x3b, 0xa1, 0xde, 0x57, 0x3c, 0x8a, 0x37, 0x10, 0x3b,
  0x1b, 0x00, 0x00, 0x00, 0x73, 0x65, 0x71, 0x75, 0x65, 0x6e, 0x74, 0x69,
  0x61, 0x6c, 0x5f, 0x31, 0x2f, 0x64, 0x65, 0x6e, 0x73, 0x65, 0x5f, 0x31,
  0x2f, 0x4d, 0x61, 0x74, 0x4d, 0x75, 0x6c, 0x00, 0x02, 0x00, 0x00, 0x00,
  0x10, 0x00, 0x00, 0x00, 0x03, 0x00, 0x00, 0x00, 0x9e, 0xfc, 0xff, 0xff,
  0x00, 0x00, 0x00, 0x01, 0x14, 0x00, 0x00, 0x00, 0xe8, 0x00, 0x00, 0x00,
  0x06, 0x00, 0x00, 0x00, 0x00, 0x00, 0x00, 0x02, 0x18, 0x01, 0x00, 0x00,
  0xd4, 0xfb, 0xff, 0xff, 0x08, 0x00, 0x00, 0x00, 0x8c, 0x00, 0x00, 0x00,
  0x10, 0x00, 0x00, 0x00, 0x00, 0x00, 0x00, 0x00, 0x00, 0x00, 0x00, 0x00,
  0x00, 0x00, 0x00, 0x00, 0x00, 0x00, 0x00, 0x00, 0x00, 0x00, 0x00, 0x00,
  0x00, 0x00, 0x00, 0x00, 0x00, 0x00, 0x00, 0x00, 0x00, 0x00, 0x00, 0x00,
  0x00, 0x00, 0x00, 0x00, 0x00, 0x00, 0x00, 0x00, 0x00, 0x00, 0x00, 0x00,
  0x00, 0x00, 0x00, 0x00, 0x00, 0x00, 0x00, 0x00, 0x00, 0x00, 0x00, 0x00,
  0x00, 0x00, 0x00, 0x00, 0x00, 0x00, 0x00, 0x00, 0x00, 0x00, 0x00, 0x00,
  0x00, 0x00, 0x00, 0x00, 0x00, 0x00, 0x00, 0x00, 0x00, 0x00, 0x00, 0x00,
  0x00, 0x00, 0x00, 0x00, 0x00, 0x00, 0x00, 0x00, 0x00, 0x00, 0x00, 0x00,
  0x00, 0x00, 0x00, 0x00, 0x00, 0x00, 0x00, 0x00, 0x00, 0x00, 0x00, 0x00,
  0x00, 0x00, 0x00, 0x00, 0x00, 0x00, 0x00, 0x00, 0x00, 0x00, 0x00, 0x00,
  0x00, 0x00, 0x00, 0x00, 0x00, 0x00, 0x00, 0x00, 0x00, 0x00, 0x00, 0x00,
  0x00, 0x00, 0x00, 0x00, 0x10, 0x00, 0x00, 0x00, 0x81, 0xd9, 0x02, 0x38,
  0x5a, 0x83, 0x15, 0x38, 0xa7, 0x4c, 0x7d, 0x37, 0xcf, 0x0e, 0x46, 0x38,
  0x93, 0x25, 0x2b, 0x38, 0xb1, 0x00, 0x33, 0x38, 0x98, 0x86, 0x1a, 0x38,
  0xe2, 0x15, 0x6b, 0x37, 0x9a, 0xc9, 0x4f, 0x38, 0x46, 0x27, 0x57, 0x38,
  0x5b, 0x72, 0x5a, 0x37, 0x7d, 0x17, 0x5d, 0x38, 0x45, 0x60, 0x3d, 0x38,
  0x44, 0x7d, 0xce, 0x37, 0x09, 0x9b, 0x58, 0x38, 0x68, 0xb5, 0x10, 0x37,
  0x36, 0x00, 0x00, 0x00, 0x73, 0x65, 0x71, 0x75, 0x65, 0x6e, 0x74, 0x69,
  0x61, 0x6c, 0x5f, 0x31, 0x2f, 0x64, 0x65, 0x6e, 0x73, 0x65, 0x5f, 0x31,
  0x2f, 0x52, 0x65, 0x6c, 0x75, 0x3b, 0x73, 0x65, 0x71, 0x75, 0x65, 0x6e,
  0x74, 0x69, 0x61, 0x6c, 0x5f, 0x31, 0x2f, 0x64, 0x65, 0x6e, 0x73, 0x65,
  0x5f, 0x31, 0x2f, 0x42, 0x69, 0x61, 0x73, 0x41, 0x64, 0x64, 0x00, 0x00,
  0x01, 0x00, 0x00, 0x00, 0x10, 0x00, 0x00, 0x00, 0xd6, 0xfd, 0xff, 0xff,
  0x00, 0x00, 0x00, 0x01, 0x14, 0x00, 0x00, 0x00, 0x84, 0x00, 0x00, 0x00,
  0x05, 0x00, 0x00, 0x00, 0x00, 0x00, 0x00, 0x09, 0x9c, 0x00, 0x00, 0x00,
  0x0c, 0xfd, 0xff, 0xff, 0x08, 0x00, 0x00, 0x00, 0x48, 0x00, 0x00, 0x00,
  0x08, 0x00, 0x00, 0x00, 0x00, 0x00, 0x00, 0x00, 0x00, 0x00, 0x00, 0x00,
  0x00, 0x00, 0x00, 0x00, 0x00, 0x00, 0x00, 0x00, 0x00, 0x00, 0x00, 0x00,
  0x00, 0x00, 0x00, 0x00, 0x00, 0x00, 0x00, 0x00, 0x00, 0x00, 0x00, 0x00,
  0x00, 0x00, 0x00, 0x00, 0x00, 0x00, 0x00, 0x00, 0x00, 0x00, 0x00, 0x00,
  0x00, 0x00, 0x00, 0x00, 0x00, 0x00, 0x00, 0x00, 0x00, 0x00, 0x00, 0x00,
  0x00, 0x00, 0x00, 0x00, 0x00, 0x00, 0x00, 0x00, 0x08, 0x00, 0x00, 0x00,
  0xfc, 0x17, 0x75, 0x3b, 0xf1, 0x90, 0x6d, 0x3b, 0xc8, 0xa8, 0xa4, 0x3b,
  0x74, 0xe6, 0x71, 0x3b, 0xca, 0x78, 0x42, 0x3c, 0x45, 0xf3, 0x39, 0x3c,
  0x63, 0xca, 0x6f, 0x3c, 0xf8, 0xbe, 0x7d, 0x3c, 0x1d, 0x00, 0x00, 0x00,
  0x73, 0x65, 0x71, 0x75, 0x65, 0x6e, 0x74, 0x69, 0x61, 0x6c, 0x5f, 0x31,
  0x2f, 0x64, 0x65, 0x6e, 0x73, 0x65, 0x5f, 0x31, 0x5f, 0x32, 0x2f, 0x4d,
  0x61, 0x74, 0x4d, 0x75, 0x6c, 0x00, 0x00, 0x00, 0x02, 0x00, 0x00, 0x00,
  0x08, 0x00, 0x00, 0x00, 0x10, 0x00, 0x00, 0x00, 0x96, 0xfe, 0xff, 0xff,
  0x00, 0x00, 0x00, 0x01, 0x14, 0x00, 0x00, 0x00, 0x84, 0x00, 0x00, 0x00,
  0x04, 0x00, 0x00, 0x00, 0x00, 0x00, 0x00, 0x02, 0xb8, 0x00, 0x00, 0x00,
  0xcc, 0xfd, 0xff, 0xff, 0x08, 0x00, 0x00, 0x00, 0x48, 0x00, 0x00, 0x00,
  0x08, 0x00, 0x00, 0x00, 0x00, 0x00, 0x00, 0x00, 0x00, 0x00, 0x00, 0x00,
  0x00, 0x00, 0x00, 0x00, 0x00, 0x00, 0x00, 0x00, 0x00, 0x00, 0x00, 0x00,
  0x00, 0x00, 0x00, 0x00, 0x00, 0x00, 0x00, 0x00, 0x00, 0x00, 0x00, 0x00,
  0x00, 0x00, 0x00, 0x00, 0x00, 0x00, 0x00, 0x00, 0x00, 0x00, 0x00, 0x00,
  0x00, 0x00, 0x00, 0x00, 0x00, 0x00, 0x00, 0x00, 0x00, 0x00, 0x00, 0x00,
  0x00, 0x00, 0x00, 0x00, 0x00, 0x00, 0x00, 0x00, 0x08, 0x00, 0x00, 0x00,
  0xf2, 0x69, 0x42, 0x38, 0x5f, 0x71, 0x3c, 0x38, 0x8a, 0x9c, 0x82, 0x38,
  0x76, 0xe1, 0x3f, 0x38, 0x6c, 0x42, 0x1a, 0x39, 0xfd, 0x7f, 0x13, 0x39,
  0x12, 0x35, 0x3e, 0x39, 0xec, 0x46, 0x49, 0x39, 0x3a, 0x00, 0x00, 0x00,
  0x73, 0x65, 0x71, 0x75, 0x65, 0x6e, 0x74, 0x69, 0x61, 0x6c, 0x5f, 0x31,
  0x2f, 0x64, 0x65, 0x6e, 0x73, 0x65, 0x5f, 0x31, 0x5f, 0x32, 0x2f, 0x52,
  0x65, 0x6c, 0x75, 0x3b, 0x73, 0x65, 0x71, 0x75, 0x65, 0x6e, 0x74, 0x69,
  0x61, 0x6c, 0x5f, 0x31, 0x2f, 0x64, 0x65, 0x6e, 0x73, 0x65, 0x5f, 0x31,
  0x5f, 0x32, 0x2f, 0x42, 0x69, 0x61, 0x73, 0x41, 0x64, 0x64, 0x00, 0x00,
  0x01, 0x00, 0x00, 0x00, 0x08, 0x00, 0x00, 0x00, 0x6e, 0xff, 0xff, 0xff,
  0x00, 0x00, 0x00, 0x01, 0x14, 0x00, 0x00, 0x00, 0x54, 0x00, 0x00, 0x00,
  0x03, 0x00, 0x00, 0x00, 0x00, 0x00, 0x00, 0x09, 0x6c, 0x00, 0x00, 0x00,
  0xa4, 0xfe, 0xff, 0xff, 0x08, 0x00, 0x00, 0x00, 0x28, 0x00, 0x00, 0x00,
  0x04, 0x00, 0x00, 0x00, 0x00, 0x00, 0x00, 0x00, 0x00, 0x00, 0x00, 0x00,
  0x00, 0x00, 0x00, 0x00, 0x00, 0x00, 0x00, 0x00, 0x00, 0x00, 0x00, 0x00,
  0x00, 0x00, 0x00, 0x00, 0x00, 0x00, 0x00, 0x00, 0x00, 0x00, 0x00, 0x00,
  0x04, 0x00, 0x00, 0x00, 0x59, 0x10, 0x37, 0x3c, 0xc7, 0xc7, 0x93, 0x3c,
  0xb8, 0xc9, 0x4f, 0x3c, 0x6e, 0xec, 0x6c, 0x3c, 0x1d, 0x00, 0x00, 0x00,
  0x73, 0x65, 0x71, 0x75, 0x65, 0x6e, 0x74, 0x69, 0x61, 0x6c, 0x5f, 0x31,
  0x2f, 0x64, 0x65, 0x6e, 0x73, 0x65, 0x5f, 0x32, 0x5f, 0x31, 0x2f, 0x4d,
  0x61, 0x74, 0x4d, 0x75, 0x6c, 0x00, 0x00, 0x00, 0x02, 0x00, 0x00, 0x00,
  0x04, 0x00, 0x00, 0x00, 0x08, 0x00, 0x00, 0x00, 0x00, 0x00, 0x16, 0x00,
  0x1c, 0x00, 0x18, 0x00, 0x17, 0x00, 0x10, 0x00, 0x0c, 0x00, 0x08, 0x00,
  0x00, 0x00, 0x00, 0x00, 0x00, 0x00, 0x07, 0x00, 0x16, 0x00, 0x00, 0x00,
  0x00, 0x00, 0x00, 0x01, 0x14, 0x00, 0x00, 0x00, 0x54, 0x00, 0x00, 0x00,
  0x02, 0x00, 0x00, 0x00, 0x00, 0x00, 0x00, 0x02, 0x6c, 0x00, 0x00, 0x00,
  0x4c, 0xff, 0xff, 0xff, 0x08, 0x00, 0x00, 0x00, 0x28, 0x00, 0x00, 0x00,
  0x04, 0x00, 0x00, 0x00, 0x00, 0x00, 0x00, 0x00, 0x00, 0x00, 0x00, 0x00,
  0x00, 0x00, 0x00, 0x00, 0x00, 0x00, 0x00, 0x00, 0x00, 0x00, 0x00, 0x00,
  0x00, 0x00, 0x00, 0x00, 0x00, 0x00, 0x00, 0x00, 0x00, 0x00, 0x00, 0x00,
  0x04, 0x00, 0x00, 0x00, 0xb3, 0x52, 0x32, 0x3a, 0x0c, 0xf4, 0x8f, 0x3a,
  0x29, 0x68, 0x4a, 0x3a, 0xb6, 0xc9, 0x66, 0x3a, 0x1e, 0x00, 0x00, 0x00,
  0x73, 0x65, 0x71, 0x75, 0x65, 0x6e, 0x74, 0x69, 0x61, 0x6c, 0x5f, 0x31,
  0x2f, 0x64, 0x65, 0x6e, 0x73, 0x65, 0x5f, 0x32, 0x5f, 0x31, 0x2f, 0x42,
  0x69, 0x61, 0x73, 0x41, 0x64, 0x64, 0x00, 0x00, 0x01, 0x00, 0x00, 0x00,
  0x04, 0x00, 0x00, 0x00, 0x00, 0x00, 0x16, 0x00, 0x20, 0x00, 0x1c, 0x00,
  0x1b, 0x00, 0x14, 0x00, 0x10, 0x00, 0x0c, 0x00, 0x00, 0x00, 0x00, 0x00,
  0x08, 0x00, 0x07, 0x00, 0x16, 0x00, 0x00, 0x00, 0x00, 0x00, 0x00, 0x01,
  0x18, 0x00, 0x00, 0x00, 0x2c, 0x00, 0x00, 0x00, 0x48, 0x00, 0x00, 0x00,
  0x01, 0x00, 0x00, 0x00, 0x00, 0x00, 0x00, 0x09, 0x60, 0x00, 0x00, 0x00,
  0x02, 0x00, 0x00, 0x00, 0xff, 0xff, 0xff, 0xff, 0x03, 0x00, 0x00, 0x00,
  0x0c, 0x00, 0x0c, 0x00, 0x00, 0x00, 0x00, 0x00, 0x08, 0x00, 0x04, 0x00,
  0x0c, 0x00, 0x00, 0x00, 0x08, 0x00, 0x00, 0x00, 0x10, 0x00, 0x00, 0x00,
  0x01, 0x00, 0x00, 0x00, 0x80, 0xff, 0xff, 0xff, 0xff, 0xff, 0xff, 0xff,
  0x01, 0x00, 0x00, 0x00, 0xb7, 0x6f, 0x80, 0x3b, 0x1d, 0x00, 0x00, 0x00,
  0x73, 0x65, 0x72, 0x76, 0x69, 0x6e, 0x67, 0x5f, 0x64, 0x65, 0x66, 0x61,
  0x75, 0x6c, 0x74, 0x5f, 0x69, 0x6e, 0x70, 0x75, 0x74, 0x5f, 0x6c, 0x61,
  0x79, 0x65, 0x72, 0x3a, 0x30, 0x00, 0x00, 0x00, 0x02, 0x00, 0x00, 0x00,
  0x01, 0x00, 0x00, 0x00, 0x03, 0x00, 0x00, 0x00, 0x02, 0x00, 0x00, 0x00,
  0x24, 0x00, 0x00, 0x00, 0x04, 0x00, 0x00, 0x00, 0xf0, 0xff, 0xff, 0xff,
  0x19, 0x00, 0x00, 0x00, 0x02, 0x00, 0x00, 0x00, 0x00, 0x00, 0x00, 0x19,
  0x0c, 0x00, 0x10, 0x00, 0x0f, 0x00, 0x00, 0x00, 0x08, 0x00, 0x04, 0x00,
  0x0c, 0x00, 0x00, 0x00, 0x09, 0x00, 0x00, 0x00, 0x04, 0x00, 0x00, 0x00,
  0x00, 0x00, 0x00, 0x09
};
unsigned int aegis_fault_model_int8_tflite_len = 3496;
```
